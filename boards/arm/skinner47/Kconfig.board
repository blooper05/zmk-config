## boards/arm/skinner47/Kconfig.board
```kconfig
config BOARD_SKINNER47_LEFT
    bool "Skinner47 left"
    depends on SOC_NRF52840_QIAA

config BOARD_SKINNER47_RIGHT
    bool "Skinner47 right"
    depends on SOC_NRF52840_QIAA
```

## boards/arm/skinner47/Kconfig.defconfig
```kconfig
if BOARD_SKINNER47_LEFT
  config ZMK_KEYBOARD_NAME
    default "Skinner47"

  config ZMK_SPLIT_ROLE_CENTRAL
    default y
endif

if BOARD_SKINNER47_LEFT || BOARD_SKINNER47_RIGHT
  config ZMK_SPLIT
    default y

  config BT_CTLR
    default BT

  if USB
    config USB_NRFX
      default y

    config USB_DEVICE_STACK
      default y
  endif

  if LVGL
    config ZMK_DISPLAY_DEDICATED_THREAD_STACK_SIZE
      default 8192

    config LV_Z_VDB_SIZE
      default 64

    config LV_DPI_DEF
      default 148

    config LV_Z_BITS_PER_PIXEL
      default 1

    choice LV_COLOR_DEPTH
      default LV_COLOR_DEPTH_1
    endchoice
  endif

  config SPI
    default y
endif
```

## boards/arm/skinner47/skinner47_left_defconfig
```kconfig
# Board & SoC Configuration
CONFIG_SOC_SERIES_NRF52X=y
CONFIG_SOC_NRF52840_QIAA=y
CONFIG_BOARD_SKINNER47_LEFT=y

# Core Hardware Drivers
CONFIG_GPIO=y
CONFIG_PINCTRL=y
CONFIG_SPI=y

# Memory & Storage
CONFIG_ARM_MPU=y
CONFIG_MPU_ALLOW_FLASH_WRITE=y
CONFIG_FLASH=y
CONFIG_FLASH_MAP=y
CONFIG_NVS=y
CONFIG_SETTINGS_NVS=y
CONFIG_USE_DT_CODE_PARTITION=y

# ZMK Core Features
CONFIG_ZMK_USB=y
CONFIG_ZMK_BLE=y
CONFIG_ZMK_STUDIO=y
CONFIG_ZMK_STUDIO_LOCKING=n

# Input Devices & Sensors
CONFIG_INPUT=y
CONFIG_ZMK_MOUSE=y
CONFIG_PMW3610=y
CONFIG_PMW3610_INVERT_X=n
CONFIG_PMW3610_INVERT_Y=y
CONFIG_PMW3610_SMART_ALGORITHM=y

# Power Management
CONFIG_ZMK_EXT_POWER=y

# Debug & Logging
CONFIG_LOG_PROCESS_THREAD_STARTUP_DELAY_MS=4000

# Build Configuration
CONFIG_BUILD_OUTPUT_UF2=y
```

## config/west.yml
```yaml
---
manifest:
  remotes:
    - name: zmkfirmware
      url-base: https://github.com/zmkfirmware
      # Additional modules containing boards/shields/custom code can be listed here as well
      # See https://docs.zephyrproject.org/3.2.0/develop/west/manifest.html#projects
    - name: badjeff
      url-base: https://github.com/badjeff
  projects:
    - name: zmk
      remote: zmkfirmware
      revision: v0.3.0
      import: app/west.yml
    - name: zmk-pmw3610-driver
      remote: badjeff
      revision: ae831defe0cfeadf117501132a3fd4b7eadb516c
    - name: zmk-split-peripheral-input-relay
      remote: badjeff
      revision: f49a5ca22a7b5626e37cffc73e97e64945bf9eb0
  self:
    path: config
```
